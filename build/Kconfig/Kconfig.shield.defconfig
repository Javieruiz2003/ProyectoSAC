## build/Kconfig/boards/Kconfig
```kconfig
# Load Zephyr board Kconfig descriptions.
osource "/opt/nordic/ncs/v3.2.1/zephyr/boards/nordic/nrf5340dk/Kconfig"
```

## build/ProyectoSAC/Kconfig/boards/Kconfig.defconfig
```kconfig
# Load Zephyr board defconfig descriptions.
osource "/opt/nordic/ncs/v3.2.1/zephyr/boards/nordic/nrf5340dk/Kconfig.defconfig"
```

## build/proyectosac/Kconfig/boards/Kconfig.defconfig
```kconfig
# Load Zephyr board defconfig descriptions.
osource "C:/ncs/v3.2.2/zephyr/boards/nordic/nrf5340dk/Kconfig.defconfig"
```

## build/proyectosac/Kconfig/boards/Kconfig.nrf5340dk
```kconfig
# Load board Kconfig descriptions.
osource "C:/ncs/v3.2.2/zephyr/boards/nordic/nrf5340dk/Kconfig.nrf5340dk"
```
